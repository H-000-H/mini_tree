/*
 * board.dts — rk3288 DTS 兼容验证示例
 *
 * 引用 rk3288.dtsi, 使能 UART0 用于 MCU 调试输出.
 * 与 Linux 内核共用同一份 .dtsi 文件, 无需修改.
 *
 * 构建:
 *   python ../../tools/dtc-lite.py board.dts ../board/generated
 */

/dts-v1/;

#include "rk3288.dtsi"

/ {
	compatible = "rockchip,rk3288";
	model = "rk3288-mcu-test";

	chosen {
		tick-rate = <1000>;
		heap-size = <32768>;
	};
};

/* 使能 UART0 作为 MCU 调试串口 */
&uart0 {
	status = "okay";
};
