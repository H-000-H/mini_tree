// SPDX-License-Identifier: Apache-2.0
/ {
	relays {
		#address-cells = <1>;
		#size-cells = <0>;

		relay_0: relay@0 {
			compatible = "gpio-relay";
			reg = <0>;
			ctl-gpio = <&gpio_relay>;
			status = "disabled";
		};
	};
};
