// SPDX-License-Identifier: Apache-2.0
/ {
	servos {
		#address-cells = <1>;
		#size-cells = <0>;

		sg90_0: servo@0 {
			compatible = "towerpro,sg90";
			reg = <0>;
			pwm = <&tim_bl>;
			channel = <1>;
			status = "disabled";
		};
	};
};
