// SPDX-License-Identifier: Apache-2.0
&uart1 {
	uart1_rs485: uart-client@3 {
		compatible = "uart-client";
		reg = <3>;
		#address-cells = <1>;
		#size-cells = <0>;
		status = "disabled";

		rs485_0: modbus@0 {
			compatible = "modbus,rtu-rs485";
			reg = <0>;
			de-gpio = <&gpio_rs485_de>;
			status = "disabled";
		};
	};
};
