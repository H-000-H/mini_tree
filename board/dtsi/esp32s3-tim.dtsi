// SPDX-License-Identifier: Apache-2.0
/*
 * ESP32-S3 TIM（LEDC 后端）— LCD 背光 PWM
 * 属性对齐 vfs-tim probe；ESP HAL 将 oc0-pin[1] 作 GPIO，autoreload 作分辨率相关 ARR
 */

#include <dt-bindings/tim/tim-parameter.h>

/ {
	soc {
		tim_bl: tim@0 {
			compatible = "tim";
			reg = <0>;
			hw-instance = <0>;
			tim-mode = <HAL_TIM_MODE_OC>;
			prescaler = <0>;
			counter-mode = <0>;
			autoreload = <1023>;
			clock-division = <0>;
			repetition-counter = <0>;
			active-chn-mask = <0x1>;
			clk-periph = <5000>; /* ESP: LEDC freq_hz */
			irqn = <-1>;
			interrupt-mask = <0>;

			oc0-compare-value = <0>;
			oc0-oc-mode = <0>;
			oc0-oc-state = <1>;
			oc0-oc-polarity = <0>;
			oc0-oc-idle-state = <0>;
			oc0-oc-n-state = <0>;
			oc0-oc-n-polarity = <0>;
			oc0-oc-n-idle-state = <0>;
			oc0-channel-id = <1>;
			oc0-chn-mode = <0>;
			oc0-chn-polarity = <0>;
			oc0-chn-filter = <0>;
			oc0-chn-prescaler = <0>;
			oc0-chn-enable-comp = <0>;
			/* [port, pin, clk, af, otype, speed, mode, pull] — ESP 用 pin */
			oc0-pin = <0 15 0 0 0 0 0 0>;

			status = "disabled";
		};
	};
};
