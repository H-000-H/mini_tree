// SPDX-License-Identifier: Apache-2.0
&i2c1 {
	mpu6050_i2c: i2c-master@104 {
		compatible = "heterogeneous,i2c-master-client";
		reg = <0x68>;
		#address-cells = <1>;
		#size-cells = <0>;
		clock-frequency = <400000>;
		status = "disabled";

		mpu6050_0: mpu6050@0 {
			compatible = "invensense,mpu6050";
			reg = <0>;
			status = "disabled";
		};
	};
};
