&spi2_master_client {
	epaper_0: epaper@4 {
		compatible = "gooddisplay,epaper";
		reg = <4>;
		dc-gpio = <&gpio_epaper_dc>;
		reset-gpio = <&gpio_epaper_rst>;
		busy-gpio = <&gpio_epaper_busy>;
		status = "disabled";
	};
};
