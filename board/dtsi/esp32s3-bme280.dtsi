// SPDX-License-Identifier: Apache-2.0
&i2c1 {
	bme280_i2c: i2c-master@118 {
		compatible = "heterogeneous,i2c-master-client";
		reg = <0x76>;
		#address-cells = <1>;
		#size-cells = <0>;
		clock-frequency = <100000>;
		status = "disabled";

		bme280_0: env@0 {
			compatible = "bosch,bme280";
			reg = <0>;
			status = "disabled";
		};
	};
};
