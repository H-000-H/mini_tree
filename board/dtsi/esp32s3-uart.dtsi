// SPDX-License-Identifier: Apache-2.0
/*
 * 厂商宏直接 #include <hal/uart_types.h>
 */

#include "esp32s3.dtsi"
#include <hal/uart_types.h>

&soc {
	uart_cap: uart-cap {
		compatible = "uart-platform-cap";
		mini-tree,platform;
		host-max = <3>;
		max-xfer = <512>;
		timeout-ms = <10>;
		event-queue = <20>;
	};

	uart1: uart@0 {
		compatible = "uart";
		reg = <0>;
		#address-cells = <1>;
		#size-cells = <0>;
		uart-base  = <UART_NUM_1>;
		uart-clk   = <0>;
		uart-baud  = <115200>;
		data-width = <UART_DATA_8_BITS>;
		parity     = <UART_PARITY_DISABLE>;
		stop-bits  = <UART_STOP_BITS_1>;

		tx-port = <0>;
		tx-pin  = <43>;
		tx-clk  = <0>;
		tx-af   = <0>;

		rx-port = <0>;
		rx-pin  = <44>;
		rx-clk  = <0>;
		rx-af   = <0>;

		status = "disabled";

		uart1_client: uart-client@0 {
			compatible = "uart-client";
			reg = <0>;
			status = "disabled";
		};
	};
};
