// SPDX-License-Identifier: Apache-2.0
/ {
	buzzers {
		#address-cells = <1>;
		#size-cells = <0>;

		buzzer_0: buzzer@0 {
			compatible = "gpio-buzzer-passive";
			reg = <0>;
			pwm = <&tim_bl>;
			beep-gpio = <&gpio_buzzer>;
			status = "disabled";
		};
	};
};
