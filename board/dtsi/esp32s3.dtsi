// SPDX-License-Identifier: Apache-2.0
/*
 * Device Tree Source for Espressif ESP32-S3 SoC
 */

/ {
	compatible = "espressif,esp32s3";
	#address-cells = <1>;
	#size-cells = <0>;

	cpus {
		#address-cells = <1>;
		#size-cells = <0>;

		cpu@0 {
			device_type = "cpu";
			compatible = "espressif,xtensa-lx7";
			reg = <0>;
			clock-frequency = <240000000>;
			status = "disabled";
		};
	};

	soc: soc {
		compatible = "simple-bus";
		ranges;
		#address-cells = <1>;
		#size-cells = <0>;
	};
};
