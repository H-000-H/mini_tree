// SPDX-License-Identifier: Apache-2.0
/*
 * ESP32-S3 板载 WS2812 RGB 灯珠
 * DevKitC-1 v1.0: GPIO48
 */

/ {
	leds {
		#address-cells = <1>;
		#size-cells = <0>;

		ws2812_rgb: ws2812@0 {
			compatible = "worldsemi,ws2812";
			reg = <0>;
			gpio-pin = <48>;
			led-count = <1>;
			status = "disabled";
		};
	};
};
