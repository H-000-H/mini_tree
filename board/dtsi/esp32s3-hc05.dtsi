// SPDX-License-Identifier: Apache-2.0
&uart1 {
	uart1_bt: uart-client@2 {
		compatible = "uart-client";
		reg = <2>;
		#address-cells = <1>;
		#size-cells = <0>;
		status = "disabled";

		hc05_0: ble@0 {
			compatible = "hc05,ble";
			reg = <0>;
			status = "disabled";
		};
	};
};
