// SPDX-License-Identifier: Apache-2.0
&i2c1 {
	ina219_i2c: ina219-i2c@64 {
		compatible = "heterogeneous,i2c-master-client";
		reg = <0x40>;
		#address-cells = <1>;
		#size-cells = <0>;
		clock-frequency = <100000>;
		status = "disabled";

		ina219_0: ina219@0 {
			compatible = "ti,ina219";
			reg = <0>;
			status = "disabled";
		};
	};
};
