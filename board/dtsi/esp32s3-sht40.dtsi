// SPDX-License-Identifier: Apache-2.0
&i2c0 {
	sht40_i2c: sht40-i2c@69 {
		compatible = "heterogeneous,i2c-master-client";
		reg = <0x45>;
		#address-cells = <1>;
		#size-cells = <0>;
		clock-frequency = <100000>;
		status = "disabled";

		sht40_0: sht40@0 {
			compatible = "sensirion,sht40";
			reg = <0>;
			status = "disabled";
		};
	};
};
