// SPDX-License-Identifier: Apache-2.0
/*
 * ADC VFS 节点模板 (vfs/adc) — 中间件占位示例
 *
 * 用法: 复制本节点到板级 dts; status 改 "okay"; 属性填厂商宏, 全 0 即默认。
 * 池大小自动 = DTC_GEN_COUNT_ADC (DTS adc 节点数, 缺省 1)。
 *
 * 数组属性宽度由 board/define/vfs/board_define_adc.h 控制 (板级可覆盖):
 *   DTS_ADC_PIN_FIELD_COUNT=8   DTS_ADC_CHANNEL_FIELD_COUNT=5
 *   DTS_ADC_MULTI_FIELD_COUNT=4 DTS_ADC_DMA_FIELD_COUNT=16
 * 元素含义:
 *   gpio-pin = <port pin clk af otype speed mode pull>
 *   multi-cfg = <multimode common-clock multi-dma sampling-delay>
 *   dma-cfg = <handle stream chan prio memsz it-en dma-en dir mode
 *              periph-inc mem-inc periph-dsz fifo-mode fifo-thr mem-burst periph-burst>
 *   channelN = <id rank sample-time diff-mode attenuation>
 * dma-irqn = <0> 表示纯轮询: 不占用 DMA 双缓冲池 (省 ~1.6 KB/实例)。
 */
/ {
adc0: adc@0 {
	compatible = "adc";
	reg = <0>;
	adc-base = <0>; /* ADC 外设寄存器基址 */
	adc-clk-bus = <0>; /* 总线时钟 */
	channel-num = <0>; /* 有效通道数 (≤ HAL_ADC_MAX_CHANNELS) */
	resolution = <0>; /* 分辨率 (12/16bit...) */
	align = <0>; /* 数据对齐 */
	sequencer-mode = <0>; /* 扫描/序列器 */
	continuous-mode = <0>; /* 连续转换 */
	trigger-src = <0>; /* 触发源 */
	sequencer-length = <0>;
	sequencer-discont = <0>; /* 间断模式 */
	eoc-flag = <0>;
	dma-mode = <0>; /* DMA 搬运模式 */
	output-buf = <0>; /* 输出缓冲 */
	internal-ch-enable = <0>; /* 内部通道供电 */
	internal-ch-select = <0>;
	dma-reg-mode = <0>;
	sw-trigger = <0>;
	gpio-pin = <0 0 0 0 0 0 0 0>;
	multi-cfg = <0 0 0 0>;
	dma-cfg = <0 0 0 0 0 0 0 0 0 0 0 0 0 0 0 0>;
	dma-irqn = <0>; /* <0> = 纯轮询; 填真实 IRQn 启用 DMA 中断 */
	status = "disabled";
};
};
