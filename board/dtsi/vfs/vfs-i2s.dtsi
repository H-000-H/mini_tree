// SPDX-License-Identifier: Apache-2.0
/*
 * I2S VFS 节点模板 (vfs/i2s) — 中间件占位示例
 *
 * 用法: 复制本节点到板级 dts; status 改 "okay"; 属性填厂商宏, 全 0 即默认。
 * 池大小自动 = DTC_GEN_COUNT_I2S_MASTER + _I2S_SLAVE (缺省各 1)。
 */
/ {
i2s0: i2s@0 {
	compatible = "i2s-master"; /* host; "i2s-slave" 为从机模式 */
	reg = <0>;
	hw-instance = <0>; /* 硬件实例号 (I2S1/I2S2...) */
	spi-base = <0>; /* I2S 外设寄存器基址 (常与 SPI 共享) */
	spi-clk  = <0>;
	dma-tx-irqn = <0>; /* TX DMA 中断号 */
	dma-rx-irqn = <0>; /* RX DMA 中断号 */
	dma-irqn    = <0>;
	irq-priority = <0>;
	it-enable = <0>;
	i2s-mode = <0>; /* 主/从/半双工/全双工 */
	i2s-standard = <0>; /* Philips/左对齐/右对齐... */
	data-format = <0>; /* 16/24/32bit 等 */
	mclk-output = <0>; /* MCLK 输出使能 */
	audio-freq = <0>; /* 采样率 Hz (0=默认) */
	status = "disabled";

	i2s0_client: i2s-master-client@0 {
		compatible = "heterogeneous,i2s-master-client"; /* client fops 节点 */
		reg = <0>;
		status = "disabled";
	};
};
};
