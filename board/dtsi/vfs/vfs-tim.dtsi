// SPDX-License-Identifier: Apache-2.0
/*
 * TIM VFS 节点模板 (vfs/tim) — 中间件占位示例
 *
 * 用法: 复制本节点到板级 dts; status 改 "okay"; 属性填厂商宏, 全 0 即默认。
 * 池大小自动 = DTC_GEN_COUNT_TIM (缺省 1)。
 * 覆盖 PWM/编码器/定时中断; 板级可放多个 tim@n 节点 (reg 区分)。
 */
/ {
tim0: tim@0 {
	compatible = "tim";
	reg = <0>;
	tim-mode = <0>; /* 定时/PWM/编码器/输入捕获... */
	prescaler = <0>; /* 预分频 */
	counter-mode = <0>; /* 递增/递减/中心对齐 */
	autoreload = <0>; /* 自动重装载值 */
	clock-division = <0>;
	repetition-counter = <0>;
	active-chn-mask = <0>; /* 使用的通道位掩码 */
	hw-instance = <0>; /* 硬件实例号 (TIM1/TIM2...) */
	clk-periph = <0>; /* 时钟总线 */
	irqn = <0>;
	interrupt-mask = <0>; /* 中断事件位掩码 */
	status = "disabled";
};
};
