// SPDX-License-Identifier: Apache-2.0
/*
 * ESP32-S3 ADC（oneshot 后端）— 属性填满 vfs-adc 必填字段；HAL 忽略 DMA 语义
 */

/ {
	soc {
		adc1: adc@1 {
			compatible = "adc";
			reg = <1>;
			adc-base = <1>;          /* ADC_UNIT_1 */
			adc-clk-bus = <0>;
			channel-num = <1>;
			resolution = <12>;
			align = <0>;
			sequencer-mode = <0>;
			continuous-mode = <0>;
			trigger-src = <0>;
			sequencer-length = <1>;
			sequencer-discont = <0>;
			eoc-flag = <0>;
			dma-mode = <0>;
			output-buf = <0>;
			/* [port, pin, clk, af, otype, speed, mode, pull] */
			gpio-pin = <0 1 0 0 0 0 0 0>;
			multi-cfg = <0 0 0 0>;
			dma-cfg = <0 0 0 0 0 0 0 0 0 0 0 0 0 0 0 0>;
			/* [channel_id, rank, sample_time, diff_mode, attenuation] */
			channel0 = <0 1 0 0 3>;
			dma-irqn = <-1>;
			status = "disabled";
		};
	};
};
