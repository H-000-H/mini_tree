// SPDX-License-Identifier: Apache-2.0
&uart1 {
	uart1_pn532: uart-client@5 {
		compatible = "uart-client";
		reg = <5>;
		#address-cells = <1>;
		#size-cells = <0>;
		status = "disabled";

		pn532_0: pn532@0 {
			compatible = "nxp,pn532-hsu";
			reg = <0>;
			status = "disabled";
		};
	};
};
