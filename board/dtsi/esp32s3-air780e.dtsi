// SPDX-License-Identifier: Apache-2.0
&uart1 {
	uart1_modem: uart-client@1 {
		compatible = "uart-client";
		reg = <1>;
		#address-cells = <1>;
		#size-cells = <0>;
		status = "disabled";

		air780e_0: modem@0 {
			compatible = "air780e,4g";
			reg = <0>;
			status = "disabled";
		};
	};
};
