// SPDX-License-Identifier: Apache-2.0
/* 产品驱动 DTS 聚合 — 默认全部 disabled */

#include "esp32s3-product-gpios.dtsi"
#include "esp32s3-sht30.dtsi"
#include "esp32s3-mpu6050.dtsi"
#include "esp32s3-at24c02.dtsi"
#include "esp32s3-ssd1306.dtsi"
#include "esp32s3-bh1750.dtsi"
#include "esp32s3-bme280.dtsi"
#include "esp32s3-ft5x06.dtsi"
#include "esp32s3-xpt2046.dtsi"
#include "esp32s3-sx1278.dtsi"
#include "esp32s3-epaper.dtsi"
#include "esp32s3-neo-m8n.dtsi"
#include "esp32s3-air780e.dtsi"
#include "esp32s3-hc05.dtsi"
#include "esp32s3-rs485-modbus.dtsi"
#include "esp32s3-drv8833.dtsi"
#include "esp32s3-sg90.dtsi"
#include "esp32s3-buzzer.dtsi"
#include "esp32s3-relay.dtsi"
#include "esp32s3-ds18b20.dtsi"
#include "esp32s3-sn65hvd230.dtsi"
#include "esp32s3-w25qxx.dtsi"
#include "esp32s3-aht20.dtsi"
#include "esp32s3-sht40.dtsi"
#include "esp32s3-bmp280.dtsi"
#include "esp32s3-vl53l0x.dtsi"
#include "esp32s3-pcf8574.dtsi"
#include "esp32s3-ads1115.dtsi"
#include "esp32s3-ina219.dtsi"
#include "esp32s3-sh1106.dtsi"
#include "esp32s3-nrf24l01.dtsi"
#include "esp32s3-rc522.dtsi"
#include "esp32s3-max7219.dtsi"
#include "esp32s3-a7670.dtsi"
#include "esp32s3-pn532.dtsi"
#include "esp32s3-dfplayer.dtsi"
