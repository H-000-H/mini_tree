// SPDX-License-Identifier: Apache-2.0
&i2c1 {
	vl53_i2c: vl53-i2c@41 {
		compatible = "heterogeneous,i2c-master-client";
		reg = <0x29>;
		#address-cells = <1>;
		#size-cells = <0>;
		clock-frequency = <400000>;
		status = "disabled";

		vl53l0x_0: vl53l0x@0 {
			compatible = "st,vl53l0x";
			reg = <0>;
			status = "disabled";
		};
	};
};
