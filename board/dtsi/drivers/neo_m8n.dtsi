// SPDX-License-Identifier: Apache-2.0
/*
 * NEO-M8N GPS 节点模板 (drivers/neo_m8n) — 中间件占位示例
 *
 * 用法: 复制到板级 dts 的 &uart0 { } 内 (挂在 uart host 下, reg = 客户端号);
 *       或挂 &uart0_client 同级; status 改 "okay"。
 * 池大小自动 = DTC_GEN_COUNT_U_BLOX_NEO_M8N (节点数, 缺省 1)。
 */
&uart0 {
neo_m8n: neo-m8n@0 {
	compatible = "u-blox,neo-m8n";
	reg = <0>; /* UART 客户端号 */
	status = "disabled";
};
};
