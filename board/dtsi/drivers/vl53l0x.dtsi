// SPDX-License-Identifier: Apache-2.0
/*
 * VL53L0X 激光测距节点模板 (drivers/vl53l0x) — 中间件占位示例
 *
 * 用法: 复制到板级 dts 的 &i2c0 { } 内; reg 填真实 7bit 地址 (典型 0x29);
 *       status 改 "okay"。
 * 池大小自动 = DTC_GEN_COUNT_ST_VL53L0X (节点数, 缺省 1)。
 */
&i2c0 {
vl53l0x: vl53l0x@0 {
	compatible = "st,vl53l0x";
	reg = <0>; /* I2C 7bit 地址, 典型 0x29 */
	status = "disabled";
};
};
