// SPDX-License-Identifier: Apache-2.0
/*
 * XPT2046 触摸屏控制器节点模板 (drivers/xpt2046) — 中间件占位示例
 *
 * 用法: 复制到板级 dts 的 &spi0 { } 内; reg = 片选序号; status 改 "okay"。
 * 池大小自动 = DTC_GEN_COUNT_TI_XPT2046 (节点数, 缺省 1)。
 */
&spi0 {
xpt2046: xpt2046@0 {
	compatible = "ti,xpt2046";
	reg = <0>; /* SPI 片选序号 */
	spi-max-frequency = <0>; /* 最大时钟 Hz (0=默认) */
	status = "disabled";
};
};
