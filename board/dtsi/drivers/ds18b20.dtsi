// SPDX-License-Identifier: Apache-2.0
/*
 * DS18B20 温度传感器节点模板 (drivers/ds18b20) — 中间件占位示例
 *
 * 用法: 单总线器件; 经 one-wire 适配或 GPIO bit-bang 时按挂载方式放对应总线下:
 *       - 经 I2C one-wire 桥接: 放 &i2c0 { } 内 (典型地址 0x18)
 *       - 直接 GPIO: 放 &gpios_pin { } 同级 (reg 可省)
 *       status 改 "okay"。
 * 池大小自动 = DTC_GEN_COUNT_MAXIM_DS18B20 (节点数, 缺省 1)。
 */
&i2c0 {
ds18b20: ds18b20@0 {
	compatible = "maxim,ds18b20";
	reg = <0>; /* 总线地址 (I2C 桥接时典型 0x18) */
	status = "disabled";
};
};
