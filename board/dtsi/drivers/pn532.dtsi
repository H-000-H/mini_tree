// SPDX-License-Identifier: Apache-2.0
/*
 * PN532 NFC 节点模板 (drivers/pn532) — 中间件占位示例
 *
 * 用法: HSU (高速 UART) 模式时挂 &uart0_client 同级或按板级实际总线;
 *       复制到板级 dts 对应总线下; status 改 "okay"。
 * 池大小自动 = DTC_GEN_COUNT_NXP_PN532_HSU (节点数, 缺省 1)。
 */
&i2c0 {
pn532: pn532@0 {
	compatible = "nxp,pn532-hsu";
	reg = <0>; /* 总线地址/片选 */
	status = "disabled";
};
};
