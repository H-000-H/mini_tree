// SPDX-License-Identifier: Apache-2.0
/*
 * PCF8574 GPIO 扩展器节点模板 (drivers/pcf8574) — 中间件占位示例
 *
 * 用法: 复制到板级 dts 的 &i2c0 { } 内; reg 填真实 7bit 地址 (典型 0x20..0x27);
 *       status 改 "okay"。
 * 池大小自动 = DTC_GEN_COUNT_NXP_PCF8574 (节点数, 缺省 1)。
 */
&i2c0 {
pcf8574: pcf8574@0 {
	compatible = "nxp,pcf8574";
	reg = <0>; /* I2C 7bit 地址, 典型 0x20..0x27 */
	status = "disabled";
};
};
