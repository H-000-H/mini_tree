// SPDX-License-Identifier: Apache-2.0
/*
 * MAX7219 LED 驱动节点模板 (drivers/max7219) — 中间件占位示例
 *
 * 用法: 复制到板级 dts 的 &spi0 { } 内; reg = 片选序号; status 改 "okay"。
 * 池大小自动 = DTC_GEN_COUNT_MAXIM_MAX7219 (节点数, 缺省 1)。
 */
&spi0 {
max7219: max7219@0 {
	compatible = "maxim,max7219";
	reg = <0>; /* SPI 片选序号 */
	spi-max-frequency = <0>; /* 最大时钟 Hz (0=默认) */
	status = "disabled";
};
};
