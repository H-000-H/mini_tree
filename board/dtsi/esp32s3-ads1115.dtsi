// SPDX-License-Identifier: Apache-2.0
&i2c1 {
	ads1115_i2c: ads1115-i2c@72 {
		compatible = "heterogeneous,i2c-master-client";
		reg = <0x48>;
		#address-cells = <1>;
		#size-cells = <0>;
		clock-frequency = <400000>;
		status = "disabled";

		ads1115_0: ads1115@0 {
			compatible = "ti,ads1115";
			reg = <0>;
			status = "disabled";
		};
	};
};
