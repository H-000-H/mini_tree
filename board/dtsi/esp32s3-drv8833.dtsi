// SPDX-License-Identifier: Apache-2.0
/ {
	motors {
		#address-cells = <1>;
		#size-cells = <0>;

		drv8833_0: hbridge@0 {
			compatible = "ti,drv8833";
			reg = <0>;
			ain1-gpio = <&gpio_motor_a1>;
			ain2-gpio = <&gpio_motor_a2>;
			bin1-gpio = <&gpio_motor_b1>;
			bin2-gpio = <&gpio_motor_b2>;
			status = "disabled";
		};
	};
};
