// SPDX-License-Identifier: Apache-2.0
/*
 * ESP32-S3 MAX98357A 功放 SDN（默认 disabled）
 * SDN 经 vfs-gpio phandle，禁止驱动直调厂家 GPIO
 */

/ {
	audio {
		#address-cells = <1>;
		#size-cells = <0>;

		speaker_amp0: amplifier@0 {
			compatible = "maxim,max98357a";
			reg = <0>;
			sdn-gpio = <&gpio_amp_sdn>;
			active-level = <1>;
			status = "disabled";
		};
	};
};
