/dts-v1/;

#include "soc/template.dtsi"
#include <dt-bindings/gpio.h>

/ {
    compatible = "your-project";
    #address-cells = <1>;
    #size-cells = <0>;
    model = "your-board";

    chosen {
        tick-rate = <1000>;
        heap-size = <32768>;
    };
};

/*
 * 移植指南:
 *
 * 1. 将 soc/template.dtsi 复制为 soc/<your-chip>.dtsi，填入实际外设地址
 * 2. 将上面的 #include 改为 #include "soc/<your-chip>.dtsi"
 * 3. 在下方用 &label 使能外设:
 *    &uart0 { status = "okay"; };
 *    &i2c0  { status = "okay"; };
 *    &spi0  { status = "okay"; };
 */
