// SPDX-License-Identifier: Apache-2.0
/*
 * CAN VFS 节点模板 (vfs/can + can_hook) — 中间件占位示例
 *
 * 用法: 复制本节点到板级 dts; status 改 "okay"; 属性填厂商宏, 全 0 即默认。
 * 池大小自动 = DTC_GEN_COUNT_CAN_HOST (缺省 1)。
 */
/ {
can0: can@0 {
	compatible = "can-host";
	reg = <0>;
	can-base = <0>; /* CAN 外设寄存器基址 */
	can-clk  = <0>; /* 总线时钟 */
	tx-port = <0>; /* TX: 端口 */
	tx-pin  = <0>;
	tx-clk  = <0>;
	tx-af   = <0>;
	rx-port = <0>; /* RX: 端口 */
	rx-pin  = <0>;
	rx-clk  = <0>;
	rx-af   = <0>;
	tx-output-type = <0>;
	tx-speed = <0>;
	tx-mode  = <0>;
	tx-pull  = <0>;
	rx-output-type = <0>;
	rx-speed = <0>;
	rx-mode  = <0>;
	rx-pull  = <0>;
	irqn = <0>;
	irq-priority = <0>;
	it-enable = <0>;
	prescaler = <0>; /* 位时序: 预分频 */
	mode = <0>; /* 工作模式 */
	sjw = <0>; /* 同步跳转宽度 */
	bs1 = <0>; /* 时间段 1 */
	bs2 = <0>; /* 时间段 2 */
	auto-bus-off = <0>; /* 自动总线恢复 */
	auto-wakeup = <0>;
	auto-retransmit = <0>;
	rx-fifo-locked = <0>; /* RX FIFO 锁定 */
	tx-fifo-prio = <0>; /* TX 优先级 */
	tt-mode = <0>; /* 时间触发模式 */
	status = "disabled";

	can0_client: can-client@0 {
		compatible = "heterogeneous,can-client"; /* client fops 节点 */
		reg = <0>;
		status = "disabled";
	};
};
};
