// SPDX-License-Identifier: Apache-2.0
/*
 * DAC VFS 节点模板 (vfs/dac) — 中间件占位示例
 *
 * 用法: 复制本节点到板级 dts; status 改 "okay"; 属性填厂商宏, 全 0 即默认。
 * 池大小自动 = DTC_GEN_COUNT_DAC (缺省 1)。
 */
/ {
dac0: dac@0 {
	compatible = "dac";
	reg = <0>;
	dac-base = <0>; /* DAC 外设寄存器基址 */
	dac-clk  = <0>;
	channel = <0>; /* 通道号 */
	trigger-source = <0>; /* 触发源 */
	data-align = <0>; /* 数据对齐 */
	output-buf = <0>; /* 输出缓冲 */
	dma-enable = <0>;
	it-enable = <0>;
	wave-auto-generation-mode = <0>; /* 波形自动生成模式 */
	wave-auto-generation-config = <0>; /* 波形配置 (幅度/周期) */
	sw-trigger = <0>;
	dma-data-align = <0>;
	gpio-pin = <0 0 0 0 0 0 0 0>;
	dma-cfg = <0 0 0 0 0 0 0 0 0 0 0 0 0 0 0 0>;
	dma-mode = <0>;
	dma-fifo-mode = <0>;
	dma-mem-burst = <0>;
	dma-periph-burst = <0>;
	dma-direction = <0>;
	dma-periph-inc = <0>;
	dma-mem-inc = <0>;
	dma-periph-data-size = <0>;
	dma-fifo-threshold = <0>;
	private-cfg = <0>; /* 平台私有配置 */
	status = "disabled";
};
};
