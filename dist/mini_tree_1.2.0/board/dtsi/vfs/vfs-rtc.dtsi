// SPDX-License-Identifier: Apache-2.0
/*
 * RTC VFS 节点模板 (vfs/rtc) — 中间件占位示例
 *
 * 用法: 复制本节点到板级 dts; status 改 "okay"; 属性填厂商宏, 全 0 即默认。
 * 池大小自动 = DTC_GEN_COUNT_RTC (缺省 1)。
 */
/ {
rtc0: rtc@0 {
	compatible = "rtc";
	reg = <0>;
	hw-instance = <0>; /* 硬件实例号 */
	clk-source = <0>; /* 时钟源 (LSE/LSI...) */
	async-prediv = <0>; /* 异步预分频 */
	sync-prediv = <0>; /* 同步预分频 */
	format-24h = <0>; /* 24 小时制: 1=开 */
	irqn = <0>;
	status = "disabled";
};
};
