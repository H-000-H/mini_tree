// SPDX-License-Identifier: Apache-2.0
/*
 * RS485 Modbus RTU 节点模板 (drivers/rs485_modbus) — 中间件占位示例
 *
 * 用法: 复制到板级 dts 的 &uart0 { } 内 (reg = 客户端号); status 改 "okay"。
 * 池大小自动 = DTC_GEN_COUNT_MODBUS_RTU_RS485 (节点数, 缺省 1)。
 */
&uart0 {
rs485_modbus: modbus-rtu-rs485@0 {
	compatible = "modbus,rtu-rs485";
	reg = <0>; /* UART 客户端号 */
	status = "disabled";
};
};
