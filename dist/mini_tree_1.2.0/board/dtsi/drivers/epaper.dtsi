// SPDX-License-Identifier: Apache-2.0
/*
 * 墨水屏 (E-paper) 节点模板 (drivers/epaper) — 中间件占位示例
 *
 * 用法: 复制到板级 dts 的 &spi0 { } 内; reg = 片选序号; status 改 "okay"。
 * 池大小自动 = DTC_GEN_COUNT_GOODDISPLAY_EPAPER (节点数, 缺省 1)。
 */
&spi0 {
epaper: epaper@0 {
	compatible = "gooddisplay,epaper";
	reg = <0>; /* SPI 片选序号 */
	spi-max-frequency = <0>; /* 最大时钟 Hz (0=默认) */
	status = "disabled";
};
};
