// SPDX-License-Identifier: Apache-2.0
/*
 * Air780E 4G 模块节点模板 (drivers/air780e) — 中间件占位示例
 *
 * 用法: 复制到板级 dts 的 &uart0 { } 内 (reg = 客户端号); status 改 "okay"。
 * 池大小自动 = DTC_GEN_COUNT_AIR780E_4G (节点数, 缺省 1)。
 */
&uart0 {
air780e: air780e@0 {
	compatible = "air780e,4g";
	reg = <0>; /* UART 客户端号 */
	status = "disabled";
};
};
