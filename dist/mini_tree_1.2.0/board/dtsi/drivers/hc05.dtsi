// SPDX-License-Identifier: Apache-2.0
/*
 * HC-05 蓝牙模块节点模板 (drivers/hc05) — 中间件占位示例
 *
 * 用法: 复制到板级 dts 的 &uart0 { } 内 (reg = 客户端号); status 改 "okay"。
 * 池大小自动 = DTC_GEN_COUNT_HC05_BLE (节点数, 缺省 1)。
 */
&uart0 {
hc05: hc05@0 {
	compatible = "hc05,ble";
	reg = <0>; /* UART 客户端号 */
	status = "disabled";
};
};
