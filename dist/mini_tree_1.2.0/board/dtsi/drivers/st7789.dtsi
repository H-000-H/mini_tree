// SPDX-License-Identifier: Apache-2.0
/*
 * ST7789 TFT LCD 节点模板 (drivers/st7789) — 中间件占位示例
 *
 * 两个变体二选一:
 *   - sitronix,st7789      有硬件 CS (挂 &spi0 下)
 *   - sitronix,st7789-nocs 无片选 (直连, 常挂 I2S/GPIO 模拟 SPI 或独立)
 * 属性: width/height 分辨率, bl-active-high 背光极性, madctl 内存访问控制,
 *       invert 颜色反转 (1=反色)。
 * 池大小自动 = 两个 compatible 节点数之和 (缺省各 1)。
 */
&spi0 {
st7789: st7789@0 {
	compatible = "sitronix,st7789";
	reg = <0>; /* SPI 片选序号 */
	width = <0>; /* 屏宽 px, 如 <240> */
	height = <0>; /* 屏高 px, 如 <320> */
	bl-active-high = <0>; /* 背光高电平有效: 1=是 */
	madctl = <0>; /* MADCTL 寄存器值 (旋转/镜像) */
	invert = <0>; /* 颜色反转: 1=反色 */
	status = "disabled";
};

st7789_nocs: st7789-nocs@0 {
	compatible = "sitronix,st7789-nocs"; /* 无片选变体 */
	reg = <0>;
	width = <0>;
	height = <0>;
	bl-active-high = <0>;
	madctl = <0>;
	invert = <0>;
	status = "disabled";
};
};
