// SPDX-License-Identifier: Apache-2.0
/*
 * SHT40 温湿度传感器节点模板 (drivers/sht40) — 中间件占位示例
 *
 * 用法: 复制到板级 dts 的 &i2c0 { } 内; reg 填真实 7bit 地址 (典型 0x44);
 *       status 改 "okay"。
 * 池大小自动 = DTC_GEN_COUNT_SENSIRION_SHT40 (节点数, 缺省 1)。
 */
&i2c0 {
sht40: sht40@0 {
	compatible = "sensirion,sht40";
	reg = <0>; /* I2C 7bit 地址, 典型 0x44 */
	status = "disabled";
};
};
