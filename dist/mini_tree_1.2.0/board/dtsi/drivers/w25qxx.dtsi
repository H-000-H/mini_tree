// SPDX-License-Identifier: Apache-2.0
/*
 * W25Qxx SPI NOR Flash 节点模板 (drivers/w25qxx) — 中间件占位示例
 *
 * 用法: 复制到板级 dts 的 &spi0 { } 内; reg = 片选序号; status 改 "okay"。
 * 池大小自动 = DTC_GEN_COUNT_WINBOND_W25QXX (节点数, 缺省 1)。
 */
&spi0 {
w25qxx: w25qxx@0 {
	compatible = "winbond,w25qxx";
	reg = <0>; /* SPI 片选序号 (0 = 第一个 CS) */
	spi-max-frequency = <0>; /* 最大时钟 Hz, 如 <80000000> (0=默认) */
	status = "disabled";
};
};
