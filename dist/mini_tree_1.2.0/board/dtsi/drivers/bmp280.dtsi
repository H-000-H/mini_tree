// SPDX-License-Identifier: Apache-2.0
/*
 * BMP280 温湿度+气压传感器节点模板 (drivers/bmp280) — 中间件占位示例
 *
 * 用法: 复制到板级 dts 的 &i2c0 { } 内; reg 填真实 7bit 地址 (典型 0x76/0x77);
 *       status 改 "okay"。
 * 池大小自动 = DTC_GEN_COUNT_BOSCH_BMP280 (节点数, 缺省 1)。
 */
&i2c0 {
bmp280: bmp280@0 {
	compatible = "bosch,bmp280";
	reg = <0>; /* I2C 7bit 地址, 典型 0x76/0x77 */
	status = "disabled";
};
};
