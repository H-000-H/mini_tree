// SPDX-License-Identifier: Apache-2.0
/*
 * ADS1115 16bit ADC 节点模板 (drivers/ads1115) — 中间件占位示例
 *
 * 用法: 复制到板级 dts 的 &i2c0 { } 内; reg 填真实 7bit 地址 (典型 0x48..0x4B);
 *       status 改 "okay"。
 * 池大小自动 = DTC_GEN_COUNT_TI_ADS1115 (节点数, 缺省 1)。
 */
&i2c0 {
ads1115: ads1115@0 {
	compatible = "ti,ads1115";
	reg = <0>; /* I2C 7bit 地址, 典型 0x48..0x4B */
	status = "disabled";
};
};
