// SPDX-License-Identifier: Apache-2.0
/*
 * 继电器节点模板 (drivers/relay) — 中间件占位示例
 *
 * 用法: GPIO 驱动, 复制到板级 dts 的 &gpios_pin { } 同级 (放 soc 下);
 *       实际引脚在 gpios_pin 节点属性中配置; status 改 "okay"。
 * 池大小自动 = DTC_GEN_COUNT_GPIO_RELAY (节点数, 缺省 1)。
 */
/ {
relay: relay@0 {
	compatible = "gpio-relay";
	reg = <0>;
	status = "disabled";
};
};
