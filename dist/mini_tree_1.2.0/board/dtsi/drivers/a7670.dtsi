// SPDX-License-Identifier: Apache-2.0
/*
 * A7670 4G 模块节点模板 (drivers/a7670) — 中间件占位示例
 *
 * 用法: 复制到板级 dts 的 &uart0 { } 内 (reg = 客户端号); status 改 "okay"。
 * 池大小自动 = DTC_GEN_COUNT_SIMCOM_A7670 (节点数, 缺省 1)。
 */
&uart0 {
a7670: a7670@0 {
	compatible = "simcom,a7670";
	reg = <0>; /* UART 客户端号 */
	status = "disabled";
};
};
