// SPDX-License-Identifier: Apache-2.0
/*
 * DRV8833 电机驱动节点模板 (drivers/drv8833) — 中间件占位示例
 *
 * 用法: 双路 PWM (AIN1/AIN2, BIN1/BIN2), 复制到板级 dts 的 &tim0 { } 同级
 *       (放 soc 下); status 改 "okay"。
 * 池大小自动 = DTC_GEN_COUNT_TI_DRV8833 (节点数, 缺省 1)。
 */
/ {
drv8833: drv8833@0 {
	compatible = "ti,drv8833";
	reg = <0>;
	status = "disabled";
};
};
