// SPDX-License-Identifier: Apache-2.0
/*
 * SX1278 LoRa 节点模板 (drivers/sx1278) — 中间件占位示例
 *
 * 用法: 复制到板级 dts 的 &spi0 { } 内; reg = 片选序号; status 改 "okay"。
 * 池大小自动 = DTC_GEN_COUNT_SEMTECH_SX1278 (节点数, 缺省 1)。
 */
&spi0 {
sx1278: sx1278@0 {
	compatible = "semtech,sx1278";
	reg = <0>; /* SPI 片选序号 */
	spi-max-frequency = <0>; /* 最大时钟 Hz (0=默认) */
	status = "disabled";
};
};
