// SPDX-License-Identifier: Apache-2.0
/*
 * 蜂鸣器节点模板 (drivers/buzzer) — 中间件占位示例
 *
 * 用法: GPIO/PWM 驱动, 复制到板级 dts 的 &gpios_pin { } 或 &tim0 同级
 *       (放 soc 下); status 改 "okay"。
 * 池大小自动 = DTC_GEN_COUNT_GPIO_BUZZER_PASSIVE (节点数, 缺省 1)。
 */
/ {
buzzer: buzzer@0 {
	compatible = "gpio-buzzer-passive";
	reg = <0>;
	status = "disabled";
};
};
