// SPDX-License-Identifier: Apache-2.0
/*
 * SSD1306 OLED 节点模板 (drivers/ssd1306) — 中间件占位示例
 *
 * 用法: 复制到板级 dts 的 &i2c0 { } 内; reg 填真实 7bit 地址 (典型 0x3C);
 *       status 改 "okay"。
 * 池大小自动 = DTC_GEN_COUNT_SOLOMON_SSD1306 (节点数, 缺省 1)。
 */
&i2c0 {
ssd1306: ssd1306@0 {
	compatible = "solomon,ssd1306";
	reg = <0>; /* I2C 7bit 地址, 典型 0x3C */
	status = "disabled";
};
};
